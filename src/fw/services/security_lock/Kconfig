## src/fw/services/security_lock/Kconfig
```kconfig
# SPDX-FileCopyrightText: 2026 Core Devices LLC
# SPDX-License-Identifier: Apache-2.0

config SERVICE_SECURITY_LOCK
    bool "Security lock"
    depends on SERVICE_TOUCH
    default y
    help
      PIN lock and data shred triggered by phone lockdown or watch-side
      tamper signals. See docs/proposals/security-lockdown.md.

      Requires touch: the lock screen is an on-screen PIN pad, so this is
      only available on the newer watches (emery, gabbro).

if SERVICE_SECURITY_LOCK

module = SERVICE_SECURITY_LOCK
module-str = Security lock
source "subsys/logging/Kconfig.template.log_level"

config SERVICE_SECURITY_LOCK_TEST_HOOKS
    bool "Security lock test hooks"
    depends on !RELEASE && !RECOVERY_FW
    default y if BOARD_QEMU_EMERY || BOARD_QEMU_FLINT || BOARD_QEMU_GABBRO
    help
      Console commands that set PINs, lock, unlock and suppress the boot
      wipe, bypassing every user-facing control. Emulator-only; never ship.

endif
```
